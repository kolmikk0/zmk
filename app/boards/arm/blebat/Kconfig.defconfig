## app/boards/arm/blebat/Kconfig.defconfig
```kconfig
# Copyright (c) 2020 Pete Johanson
# SPDX-License-Identifier: MIT

if BOARD_BLEBAT

config BOARD
	default "blebat"

config ZMK_KEYBOARD_NAME
	default "blebat"

if USB

config USB_NRFX
	default y

config USB_DEVICE_STACK
	default y

endif # USB

config BT_CTLR
	default BT

config ZMK_BLE
	default y

config ZMK_USB
	default y

config ZMK_BATTERY_VOLTAGE_DIVIDER
	default y

if ZMK_DISPLAY

config ILI9340
    default y

choice ZMK_DISPLAY_STATUS_SCREEN
	default ZMK_DISPLAY_STATUS_SCREEN_CUSTOM

endchoice

endif # ZMK_DISPLAY

if LVGL

config LVGL_HOR_RES_MAX
	default 240

config LVGL_VER_RES_MAX
	default 320

config LVGL_VDB_SIZE
	default 16

config LVGL_DPI
	default 30

# config LVGL_BITS_PER_PIXEL
# 	default 1

choice LVGL_COLOR_DEPTH
	default LVGL_COLOR_DEPTH_32
endchoice

endif

source "/home/steven/gitproj/zmk/app/steno/Kconfig"

endif # BOARD_BLEBAT
```

## app/boards/arm/blebat/blebat_defconfig
```kconfig
# SPDX-License-Identifier: MIT

CONFIG_SOC_SERIES_NRF52X=y
CONFIG_SOC_NRF52840_QIAA=y
CONFIG_BOARD_BLEBAT=y

# Enable MPU
CONFIG_ARM_MPU=y

# enable GPIO
CONFIG_GPIO=y

CONFIG_USE_DT_CODE_PARTITION=y

CONFIG_MPU_ALLOW_FLASH_WRITE=y
CONFIG_NVS=y
CONFIG_SETTINGS_NVS=y
CONFIG_FLASH=y
CONFIG_FLASH_PAGE_LAYOUT=y
CONFIG_FLASH_MAP=y

CONFIG_PWM=y
CONFIG_SPI=y
CONFIG_NRFX_SPIM0=y
CONFIG_SPI_NOR=y

CONFIG_ZMK_DISPLAY=y
CONFIG_ZMK_DISPLAY_STATUS_SCREEN_CUSTOM=y
CONFIG_ZMK_EMBEDDED_STENO=y
CONFIG_ZMK_EMBEDDED_STENO_KEY_INTERVAL=3
CONFIG_ZMK_EMBEDDED_STENO_NOUNICODE=y
CONFIG_ZMK_EMBEDDED_STENO_LOG_BACKEND_CONSOLE=y
CONFIG_ZMK_EMBEDDED_STENO_DEBUG_HIST=y
```

## app/boards/arm/fissure/Kconfig.board
```kconfig
# Copyright (c) 2020 Pete Johanson
# SPDX-License-Identifier: MIT

config BOARD_FISSURE_RIGHT
	bool "fissure right"
	depends on SOC_NRF52840_QIAA

config BOARD_FISSURE_LEFT
	bool "fissure left"
	depends on SOC_NRF52840_QIAA

# config BOARD_ENABLE_DCDC
# 	bool "Enable DCDC mode"
# 	select SOC_DCDC_NRF52X
# 	default y
# 	depends on BOARD_FISSURE_LEFT || BOARD_FISSURE_RIGHT
```

## app/boards/arm/fissure/Kconfig.defconfig
```kconfig
if BOARD_FISSURE_LEFT || BOARD_FISSURE_RIGHT

config BOARD
	default "fissure"

config ZMK_KEYBOARD_NAME
	default "Fissure v3.3"

if USB

config USB_NRFX
	default y

config USB_DEVICE_STACK
	default y

endif # USB

config BT_CTLR
	default BT

config ZMK_BLE
	default y

config ZMK_USB
	default y

config ZMK_BATTERY_VOLTAGE_DIVIDER
	default y

if ZMK_DISPLAY

config I2C
	default y

config SSD1306
	default y

# config SSD1306_REVERSE_MODE
# 	default y

endif # ZMK_DISPLAY

if LVGL

config LVGL_HOR_RES_MAX
	default 128

config LVGL_VER_RES_MAX
	default 32

config LVGL_VDB_SIZE
	default 50

config LVGL_BITS_PER_PIXEL
	default 1

choice LVGL_COLOR_DEPTH
	default LVGL_COLOR_DEPTH_1
endchoice

endif

source "/home/steven/gitproj/zmk/app/steno/Kconfig"

endif
```

## app/boards/arm/fissure/fissure_left_defconfig
```kconfig
# SPDX-License-Identifier: MIT
CONFIG_ZMK_SPLIT=y

CONFIG_SOC_SERIES_NRF52X=y
CONFIG_SOC_NRF52840_QIAA=y

# Enable MPU
CONFIG_ARM_MPU=y

# enable GPIO
CONFIG_GPIO=y
CONFIG_LED=y
CONFIG_PWM=y
CONFIG_LED_PWM=y

CONFIG_USE_DT_CODE_PARTITION=y

CONFIG_MPU_ALLOW_FLASH_WRITE=y
CONFIG_NVS=y
CONFIG_SETTINGS_NVS=y
CONFIG_FLASH=y
CONFIG_FLASH_PAGE_LAYOUT=y
CONFIG_FLASH_MAP=y

# CONFIG_I2C=y
# CONFIG_SSD1306=y

# CONFIG_ZMK_USB_LOGGING=y
CONFIG_ZMK_LOG_LEVEL=4
# CONFIG_LOG=y
# CONFIG_CONSOLE=y
# CONFIG_USE_SEGGER_RTT=y
# CONFIG_RTT_CONSOLE=y
# # CONFIG_USB_UART_CONSOLE=n
# CONFIG_UART_CONSOLE=n
# # CONFIG_LOG_MODE_IMMEDIATE=y
# CONFIG_LOG_STRDUP_BUF_COUNT=32

CONFIG_ZMK_IDLE_TIMEOUT=10000
CONFIG_ZMK_LED_WIDGETS=y
CONFIG_BT_BUF_ACL_TX_COUNT=32
```

## app/boards/arm/fissure/fissure_right_defconfig
```kconfig
# SPDX-License-Identifier: MIT
CONFIG_ZMK_SPLIT=y
CONFIG_ZMK_SPLIT_BLE_ROLE_CENTRAL=y

CONFIG_SOC_SERIES_NRF52X=y
CONFIG_SOC_NRF52840_QIAA=y

# Enable MPU
CONFIG_ARM_MPU=y

CONFIG_GPIO=y
CONFIG_LED=y
CONFIG_PWM=y
CONFIG_LED_PWM=y

CONFIG_USE_DT_CODE_PARTITION=y

CONFIG_MPU_ALLOW_FLASH_WRITE=y
CONFIG_NVS=y
CONFIG_SETTINGS_NVS=y
CONFIG_FLASH=y
CONFIG_FLASH_PAGE_LAYOUT=y
CONFIG_FLASH_MAP=y

CONFIG_NORDIC_QSPI_NOR=y

CONFIG_ZMK_DISPLAY=n

CONFIG_ZMK_USB_LOGGING=n
CONFIG_ZMK_LOG_LEVEL=3
# CONFIG_LOG=y
# CONFIG_CONSOLE=y
# CONFIG_USE_SEGGER_RTT=y
# CONFIG_RTT_CONSOLE=y
# CONFIG_USB_UART_CONSOLE=n
# CONFIG_UART_CONSOLE=n

CONFIG_ZMK_EMBEDDED_STENO=y
CONFIG_ZMK_EMBEDDED_STENO_KEY_INTERVAL=3
CONFIG_ZMK_EMBEDDED_STENO_ENABLE_UI=y
CONFIG_ZMK_EMBEDDED_UI_SCREEN_SMALL_OLED=y
CONFIG_ZMK_EMBEDDED_STENO_NOUNICODE=y
CONFIG_ZMK_EMBEDDED_STENO_LOG_BACKEND_CONSOLE=n
CONFIG_ZMK_EMBEDDED_STENO_DEBUG_HIST=n
CONFIG_ZMK_EMBEDDED_STENO_DICTEDIT=n

CONFIG_ZMK_BLE_KEYBOARD_REPORT_QUEUE_SIZE=256

CONFIG_LOG_STRDUP_BUF_COUNT=32
CONFIG_ZMK_IDLE_TIMEOUT=10000
CONFIG_ZMK_SLEEP=y
CONFIG_ZMK_IDLE_SLEEP_TIMEOUT=600000
CONFIG_ZMK_LED_WIDGETS=y
```

## app/boards/arm/folded_bat/folded_bat_defconfig
```kconfig
# SPDX-License-Identifier: MIT

CONFIG_SOC_SERIES_NRF52X=y
CONFIG_SOC_NRF52840_QIAA=y
CONFIG_BOARD_FOLDED_BAT=y

# Enable MPU
CONFIG_ARM_MPU=y

# enable GPIO
CONFIG_GPIO=y

CONFIG_USE_DT_CODE_PARTITION=y

CONFIG_MPU_ALLOW_FLASH_WRITE=y
CONFIG_NVS=y
CONFIG_SETTINGS_NVS=y
CONFIG_FLASH=y
CONFIG_FLASH_PAGE_LAYOUT=y
CONFIG_FLASH_MAP=y

# CONFIG_RING_BUFFER=y

CONFIG_SPI=y
CONFIG_NRFX_SPIM0=y
CONFIG_SPI_NOR=y

CONFIG_ZMK_DISPLAY=y
CONFIG_ZMK_WIDGET_BATTERY_STATUS=y
CONFIG_ZMK_WIDGET_OUTPUT_STATUS=y
CONFIG_ZMK_WIDGET_LAYER_STATUS=y
CONFIG_ZMK_WIDGET_WPM_STATUS=y

CONFIG_ZMK_USB_LOGGING=y
# CONFIG_ZMK_EMBEDDED_STENO=y
# CONFIG_ZMK_EMBEDDED_STENO_KEY_INTERVAL=10
# CONFIG_ZMK_EMBEDDED_STENO_NOUI=y
# CONFIG_ZMK_EMBEDDED_STENO_NOUNICODE=y
# CONFIG_ZMK_EMBEDDED_STENO_LOG_BACKEND_CONSOLE=y
# CONFIG_ZMK_EMBEDDED_STENO_DEBUG_HIST=y
# CONFIG_ZMK_EMBEDDED_STENO_READONLY=y

CONFIG_LVGL_USE_THEME_MONO=y
CONFIG_LVGL_THEME_DEFAULT_COLOR_PRIMARY_WHITE=y
CONFIG_LVGL_THEME_DEFAULT_COLOR_SECONDARY_BLACK=y

# CONFIG_LOG_BACKEND_SWO=y
# CONFIG_LOG_BACKEND_RTT=y
```

## app/boards/arm/fusion_h/Kconfig.board
```kconfig
# Copyright (c) 2020 Pete Johanson
# SPDX-License-Identifier: MIT

config BOARD_FUSION_H
	bool "Fusion H"
	depends on SOC_NRF52840_QIAA

config BOARD_ENABLE_DCDC
	bool "Enable DCDC mode"
	select SOC_DCDC_NRF52X
	default y
	depends on BOARD_FUSION_H
```

## app/boards/arm/fusion_h/fusion_h_defconfig
```kconfig
# SPDX-License-Identifier: MIT

CONFIG_SOC_SERIES_NRF52X=y
CONFIG_SOC_NRF52840_QIAA=y
CONFIG_BOARD_FUSION_H=y

# Enable MPU
CONFIG_ARM_MPU=y

# enable GPIO
CONFIG_GPIO=y

CONFIG_USE_DT_CODE_PARTITION=y

CONFIG_MPU_ALLOW_FLASH_WRITE=y
CONFIG_NVS=y
CONFIG_SETTINGS_NVS=y
CONFIG_FLASH=y
CONFIG_FLASH_PAGE_LAYOUT=y
CONFIG_FLASH_MAP=y

CONFIG_SPI=y
CONFIG_NRFX_SPIM0=y
CONFIG_SPI_NOR=y

CONFIG_ZMK_KSCAN_COMPOSITE_DRIVER=y
CONFIG_ZMK_COMBO_MAX_COMBOS_PER_KEY=8

CONFIG_ZMK_DISPLAY=y
CONFIG_ZMK_DISPLAY_STATUS_SCREEN_CUSTOM=y
CONFIG_ZMK_WIDGET_BATTERY_STATUS=y
CONFIG_ZMK_WIDGET_OUTPUT_STATUS=y
CONFIG_ZMK_WIDGET_LAYER_STATUS=y
CONFIG_ZMK_WIDGET_WPM_STATUS=y

CONFIG_ZMK_USB_LOGGING=n
CONFIG_ZMK_LOG_LEVEL_INF=y
CONFIG_ZMK_EMBEDDED_STENO=y
CONFIG_ZMK_BLE_KEYBOARD_REPORT_QUEUE_SIZE=256
CONFIG_ZMK_EMBEDDED_STENO_DISP_INVERT=y
CONFIG_ZMK_EMBEDDED_STENO_FONT_ADASCII_8=y
CONFIG_ZMK_EMBEDDED_STENO_KEY_INTERVAL=3
CONFIG_ZMK_EMBEDDED_STENO_NOUNICODE=y
CONFIG_ZMK_EMBEDDED_STENO_LOG_BACKEND_CONSOLE=n
CONFIG_ZMK_EMBEDDED_STENO_DEBUG_HIST=n
```

## app/boards/arm/musk/musk_defconfig
```kconfig
# SPDX-License-Identifier: MIT

CONFIG_SOC_SERIES_NRF52X=y
CONFIG_SOC_NRF52840_QIAA=y
CONFIG_BOARD_MUSK=y

# Enable MPU
CONFIG_ARM_MPU=y

# enable GPIO
CONFIG_GPIO=y
CONFIG_LED=y
CONFIG_PWM=y
CONFIG_LED_PWM=y

CONFIG_USE_DT_CODE_PARTITION=y

CONFIG_MPU_ALLOW_FLASH_WRITE=y
CONFIG_NVS=y
CONFIG_SETTINGS_NVS=y
CONFIG_FLASH=y
CONFIG_FLASH_PAGE_LAYOUT=y
CONFIG_FLASH_MAP=y

CONFIG_SPI=y
# CONFIG_SPI_NOR=y

CONFIG_ZMK_COMBO_MAX_COMBOS_PER_KEY=8
CONFIG_ZMK_KSCAN_DEBOUNCE_PRESS_MS=2
CONFIG_ZMK_KSCAN_DEBOUNCE_RELEASE_MS=4

# CONFIG_ZMK_EMBEDDED_STENO=y
# CONFIG_ZMK_BLE_KEYBOARD_REPORT_QUEUE_SIZE=256
# CONFIG_ZMK_EMBEDDED_STENO_DISP_INVERT=y
# CONFIG_ZMK_EMBEDDED_STENO_FONT_ADASCII_8=y
# CONFIG_ZMK_EMBEDDED_STENO_KEY_INTERVAL=3
# CONFIG_ZMK_EMBEDDED_STENO_NOUNICODE=y
# CONFIG_ZMK_EMBEDDED_STENO_LOG_BACKEND_CONSOLE=n
# CONFIG_ZMK_EMBEDDED_STENO_DEBUG_HIST=n

CONFIG_ZMK_MOUSE=n
CONFIG_ZMK_SLEEP=y
CONFIG_ZMK_IDLE_SLEEP_TIMEOUT=420000
CONFIG_ZMK_LED_WIDGETS=y

# CONFIG_BT_PERIPHERAL_PREF_MIN_INT=6
# CONFIG_BT_PERIPHERAL_PREF_MAX_INT=12

CONFIG_SENSOR_INIT_PRIORITY=80
CONFIG_PMW3610=y

CONFIG_CLOCK_CONTROL_NRF_K32SRC_SYNTH=y

CONFIG_LOG=y
CONFIG_DEBUG=y
CONFIG_CONSOLE=y
CONFIG_USE_SEGGER_RTT=y
CONFIG_RTT_CONSOLE=y
CONFIG_SENSOR_LOG_LEVEL_DBG=y
CONFIG_PMW3610_LOG_LEVEL_DBG=y
CONFIG_ZMK_LOG_LEVEL_INF=y
CONFIG_LVGL_LOG_LEVEL_WRN=y
CONFIG_ZMK_USB_LOGGING=n
CONFIG_LOG_BUFFER_SIZE=8192
CONFIG_SEGGER_RTT_BUFFER_SIZE_UP=8192
CONFIG_ASSERT=y
CONFIG_LOG_PROCESS_THREAD_SLEEP_MS=100
CONFIG_ZMK_BLE_THREAD_STACK_SIZE=4096
CONFIG_LOG_PROCESS_THREAD_STACK_SIZE=4096
CONFIG_ZMK_BLE_SPLIT_CENTRAL_SPLIT_RUN_STACK_SIZE=4096
CONFIG_HW_STACK_PROTECTION=y
CONFIG_MAIN_STACK_SIZE=4096
```

## app/boards/arm/uni4/Kconfig.defconfig
```kconfig
# Copyright (c) 2021 Yonatan Schachter
# SPDX-License-Identifier: Apache-2.0

if BOARD_UNI4

config BOARD
	default "uni4"

config RP2_FLASH_W25Q080
	default y

source "$srctree/../app/steno/Kconfig"

endif # BOARD_UNI4
```

## app/boards/arm/uni4/uni4_defconfig
```kconfig
CONFIG_SOC_SERIES_RP2XXX=y
CONFIG_SOC_RP2040=y
CONFIG_SYS_CLOCK_HW_CYCLES_PER_SEC=125000000
CONFIG_SERIAL=n
CONFIG_CONSOLE=n
CONFIG_UART_CONSOLE=n
CONFIG_GPIO=y
CONFIG_USE_DT_CODE_PARTITION=y
CONFIG_BUILD_OUTPUT_UF2=y
CONFIG_UART_INTERRUPT_DRIVEN=n
CONFIG_ZMK_USB=y

CONFIG_ZMK_EMBEDDED_STENO=n
CONFIG_ZMK_BLE_KEYBOARD_REPORT_QUEUE_SIZE=256
CONFIG_ZMK_EMBEDDED_STENO_ENABLE_UI=n
CONFIG_ZMK_EMBEDDED_STENO_DICTEDIT=n
CONFIG_ZMK_EMBEDDED_STENO_KEY_INTERVAL=3
CONFIG_ZMK_EMBEDDED_STENO_NOUNICODE=y
CONFIG_ZMK_EMBEDDED_STENO_LOG_BACKEND_CONSOLE=n
CONFIG_ZMK_EMBEDDED_STENO_DEBUG_HIST=n
```

## app/boards/shields/wren/Kconfig.defconfig
```kconfig
# Copyright (c) 2020 The ZMK Contributors
# SPDX-License-Identifier: MIT

if SHIELD_WREN

config ZMK_KEYBOARD_NAME
    default "Wren"

config ZMK_USB
    default y

endif
```

## app/drivers/zephyr/dts/bindings/kscan/zmk,kscan-gpio-charlieplex.yaml
```yaml
# Copyright (c) 2020, Pete Johanson
# SPDX-License-Identifier: MIT

description: GPIO keyboard Charlieplex matrix controller

compatible: "zmk,kscan-gpio-charlieplex"

include: kscan.yaml

properties:
  gpios:
    type: phandle-array
    required: true
  debounce-period:
    type: int
    default: 5
```
